## main/Kconfig.projbuild
```kconfig
menu "COHI-Player"

    config COHI_AUTOPLAY
        bool "Autoplay beim Einschalten"
        default y
        help
            Findet die Firmware nach dem Start auf der SD-Karte die unten genannte Playlist,
            wird sie ohne Konsolenaktion abgespielt (Endlosschleife, ausser die Playlist enthaelt
            die Direktive "#COHI once"). Ein Tastendruck im Abbruchfenster verhindert den Start.

    config COHI_AUTOPLAY_FILE
        string "Name der Autoplay-Playlist (Wurzel der SD-Karte)"
        default "/autoplay.m3u"
        depends on COHI_AUTOPLAY

    config COHI_AUTOPLAY_DELAY_S
        int "Abbruchfenster vor dem Autostart in Sekunden (0 = sofort)"
        range 0 30
        default 3
        depends on COHI_AUTOPLAY
        help
            Beim Oeffnen eines Terminals setzt die USB-UART-Bruecke das Board meist zurueck.
            In diesem Fenster genuegt eine beliebige Taste, damit der Autoplay nicht anlaeuft.

    config COHI_DEFAULT_OFFSET_BINARY
        bool "Standard: Offset-Binary-DAC (Stille = Mittencode 0x80 / 0x8000)"
        default n
        help
            Bestimmt den Pegel der Datenpins ab dem Einschalten (noch vor dem Lesen der SD-Karte)
            und den Startwert von "offset". Die Playlist-Direktive "#COHI offset=on|off" ueberschreibt ihn.

endmenu
```

## sdkconfig.defaults
```kconfig
# --- Ziel / Chip ------------------------------------------------------------
CONFIG_IDF_TARGET="esp32p4"
# Rev 3.x (v3.2): 400 MHz moeglich (Rev < 3 -> nur 360 MHz)
CONFIG_ESP32P4_REV_MIN_300=y
CONFIG_ESP_DEFAULT_CPU_FREQ_MHZ_400=y

# --- Flash (wie parlioSDR) --------------------------------------------------
CONFIG_ESPTOOLPY_FLASHMODE_DIO=y
CONFIG_ESPTOOLPY_FLASHFREQ_40M=y
CONFIG_ESPTOOLPY_FLASHSIZE_2MB=y
CONFIG_PARTITION_TABLE_SINGLE_APP=y

# --- PSRAM (Hex, 80 MHz wie parlioSDR; DMA-Bedarf <= 40 MB/s) ---------------
CONFIG_SPIRAM=y
CONFIG_SPIRAM_MODE_HEX=y
CONFIG_SPIRAM_SPEED_80M=y
CONFIG_SPIRAM_MEMTEST=n
CONFIG_SPIRAM_USE_MALLOC=y
CONFIG_SPIRAM_MALLOC_ALWAYSINTERNAL=16384
CONFIG_SPIRAM_MALLOC_RESERVE_INTERNAL=32768
CONFIG_CACHE_L2_CACHE_128KB=y
CONFIG_CACHE_L2_CACHE_LINE_64B=y

# --- Performance ------------------------------------------------------------
CONFIG_COMPILER_OPTIMIZATION_PERF=y
CONFIG_FREERTOS_HZ=1000
# DSP-Task auf Core 1 laeuft im Rueckstand ohne Idle -> Idle-Watchdog fuer CPU1 aus
CONFIG_ESP_TASK_WDT_CHECK_IDLE_TASK_CPU1=n

# --- PARLIO -----------------------------------------------------------------
CONFIG_PARLIO_TX_ISR_HANDLER_IN_IRAM=y
CONFIG_PARLIO_OBJ_CACHE_SAFE=y

# --- FAT / SD ---------------------------------------------------------------
CONFIG_FATFS_LFN_HEAP=y
CONFIG_FATFS_MAX_LFN=255
CONFIG_FATFS_VFS_FSTAT_BLKSIZE=0

# --- Konsole ----------------------------------------------------------------
CONFIG_ESP_CONSOLE_UART_DEFAULT=y
CONFIG_ESP_CONSOLE_UART_BAUDRATE=115200
CONFIG_ESP_MAIN_TASK_STACK_SIZE=6144
CONFIG_LOG_DEFAULT_LEVEL_INFO=y
```
